## bootloader/main/Kconfig.projbuild
```kconfig
menu "S31 audio co-processor"

config S31_AUDIO_ENABLE
	bool "Enable FreeRTOS-owned ES8311 audio"
	default y

if S31_AUDIO_ENABLE

config S31_AUDIO_I2C_SDA
	int "ES8311 I2C SDA GPIO"
	default 51

config S31_AUDIO_I2C_SCL
	int "ES8311 I2C SCL GPIO"
	default 50

config S31_AUDIO_I2S_MCLK
	int "ES8311 I2S MCLK GPIO (-1 to omit)"
	default 52

config S31_AUDIO_I2S_BCLK
	int "ES8311 I2S BCLK GPIO"
	default 53

config S31_AUDIO_I2S_WS
	int "ES8311 I2S word-select GPIO"
	default 55

config S31_AUDIO_I2S_DOUT
	int "ES8311 I2S data-out GPIO"
	default 56

config S31_AUDIO_I2S_DIN
	int "ES8311 I2S data-in GPIO"
	default 54

config S31_AUDIO_PA_GPIO
	int "Power amplifier enable GPIO (-1 to omit)"
	default 57

config S31_AUDIO_MIC_RIGHT_SLOT
	bool "ES8311 microphone is in the right I2S slot"
	default n

endif

endmenu
```

## bt-latency/native-idf/spp/sdkconfig.defaults
```kconfig
# Override some defaults so BT stack is enabled
CONFIG_BT_ENABLED=y
CONFIG_BTDM_CTRL_MODE_BLE_ONLY=n
CONFIG_BTDM_CTRL_MODE_BR_EDR_ONLY=y
CONFIG_BTDM_CTRL_MODE_BTDM=n
CONFIG_BT_CLASSIC_ENABLED=y
CONFIG_BT_SPP_ENABLED=y
CONFIG_BT_BLE_ENABLED=n

CONFIG_IDF_EXPERIMENTAL_FEATURES=y
CONFIG_COMPILER_OPTIMIZATION_PERF=y
CONFIG_ESP_DEFAULT_CPU_FREQ_MHZ_320=y
CONFIG_FREERTOS_HZ=1000
CONFIG_ESPTOOLPY_FLASHMODE_DIO=y
CONFIG_ESPTOOLPY_FLASHFREQ_80M=y
CONFIG_ESPTOOLPY_FLASHSIZE_16MB=y
CONFIG_PARTITION_TABLE_CUSTOM=y
CONFIG_PARTITION_TABLE_CUSTOM_FILENAME="partitions.csv"
CONFIG_PARTITION_TABLE_OFFSET=0x10000
CONFIG_ESP_CONSOLE_UART_DEFAULT=y
CONFIG_ESP_CONSOLE_UART_BAUDRATE=115200
CONFIG_BT_CTRL_SLEEP_ENABLE=n

CONFIG_BT_BLUEDROID_ENABLED=y
CONFIG_EXAMPLE_LOCAL_DEVICE_NAME="S31 Native SPP"
```

## buildroot-external/Config.in
```kconfig
menu "ESP32-S31 packages"

source "$BR2_EXTERNAL_ESP32_S31_PATH/package/esp-simd/Config.in"
source "$BR2_EXTERNAL_ESP32_S31_PATH/package/s31-tools/Config.in"
source "$BR2_EXTERNAL_ESP32_S31_PATH/package/s31-crypto/Config.in"
source "$BR2_EXTERNAL_ESP32_S31_PATH/package/btstack-s31/Config.in"

endmenu
```

## buildroot-external/configs/esp32s31_rootfs_defconfig
```kconfig
BR2_riscv=y
BR2_riscv_custom=y
BR2_RISCV_ISA_RVM=y
BR2_RISCV_ISA_RVA=y
BR2_RISCV_ISA_RVF=y
BR2_RISCV_ISA_RVC=y
BR2_RISCV_ISA_EXTRA="zaamo_zalrsc_zba_zbb_zbc_zbs"
BR2_RISCV_32=y
BR2_RISCV_USE_MMU=y
BR2_RISCV_ABI_ILP32=y
BR2_TOOLCHAIN_EXTERNAL=y
BR2_TOOLCHAIN_EXTERNAL_CUSTOM=y
BR2_TOOLCHAIN_EXTERNAL_PREINSTALLED=y
BR2_TOOLCHAIN_EXTERNAL_PATH="$(BR2_EXTERNAL_ESP32_S31_PATH)/../toolchain/riscv32-esp-linux-musl"
BR2_TOOLCHAIN_EXTERNAL_CUSTOM_PREFIX="riscv32-esp-linux-musl"
BR2_TOOLCHAIN_EXTERNAL_GCC_15=y
BR2_TOOLCHAIN_EXTERNAL_HEADERS_6_12=y
BR2_TOOLCHAIN_EXTERNAL_CUSTOM_MUSL=y
BR2_TOOLCHAIN_EXTERNAL_CXX=y
BR2_TARGET_OPTIMIZATION="-Os -march=rv32imafbc_zicsr_zifencei_zaamo_zalrsc_zba_zbb_zbc_zbs -mabi=ilp32 -mtune=esp-base"
BR2_TARGET_GENERIC_HOSTNAME="esp32-s31"
BR2_TARGET_GENERIC_ISSUE="ESP32-S31 Linux (Buildroot)"
BR2_SYSTEM_DHCP="eth0"
# BR2_TARGET_GENERIC_REMOUNT_ROOTFS_RW is not set
BR2_INIT_BUSYBOX=y
BR2_PACKAGE_BUSYBOX_CONFIG_FRAGMENT_FILES="$(BR2_EXTERNAL_ESP32_S31_PATH)/board/esp32-s31/busybox.fragment"
BR2_ROOTFS_DEVICE_CREATION_DYNAMIC_DEVTMPFS=y
BR2_ROOTFS_OVERLAY="$(BR2_EXTERNAL_ESP32_S31_PATH)/board/esp32-s31/overlay"
BR2_ROOTFS_POST_BUILD_SCRIPT="$(BR2_EXTERNAL_ESP32_S31_PATH)/board/esp32-s31/post-build.sh"
BR2_GLOBAL_PATCH_DIR="$(BR2_EXTERNAL_ESP32_S31_PATH)/patches"
BR2_PACKAGE_BUSYBOX_SHOW_OTHERS=y
# esp32-config intentionally requires the ncurses dialog frontend.
BR2_PACKAGE_DIALOG=y
# Use the standard Linux userspace control planes for the native cfg80211,
# Bluetooth HCI and GPIO character-device drivers.
BR2_PACKAGE_WPA_SUPPLICANT=y
BR2_PACKAGE_WPA_SUPPLICANT_NL80211=y
# BR2_PACKAGE_WPA_SUPPLICANT_WEXT is not set
BR2_PACKAGE_WPA_SUPPLICANT_CLI=y
BR2_PACKAGE_WPA_SUPPLICANT_PASSPHRASE=y
BR2_PACKAGE_WPA_SUPPLICANT_CTRL_IFACE=y
BR2_PACKAGE_HOSTAPD=y
BR2_PACKAGE_HOSTAPD_DRIVER_NL80211=y
BR2_PACKAGE_LIBGPIOD2=y
BR2_PACKAGE_LIBGPIOD2_TOOLS=y
BR2_PACKAGE_LINUXPTP=y
BR2_PACKAGE_I2C_TOOLS=y
BR2_PACKAGE_SPIDEV_TEST=y
BR2_PACKAGE_ALSA_UTILS=y
# BR2_PACKAGE_ALSA_UTILS_ALSACTL is not set
# BR2_PACKAGE_ALSA_UTILS_ALSAMIXER is not set
BR2_PACKAGE_ALSA_UTILS_APLAY=y
BR2_PACKAGE_ALSA_LIB_PCM_PLUGINS="null extplug ioplug"
BR2_PACKAGE_ALSA_LIB_CTL_PLUGINS="ext"
# BR2_PACKAGE_ALSA_LIB_ALOAD is not set
# BR2_PACKAGE_ALSA_LIB_MIXER is not set
# BR2_PACKAGE_ALSA_LIB_RAWMIDI is not set
# BR2_PACKAGE_ALSA_LIB_HWDEP is not set
# BR2_PACKAGE_ALSA_LIB_SEQ is not set
# BR2_PACKAGE_ALSA_LIB_UCM is not set
# BR2_PACKAGE_ALSA_LIB_OLD_SYMBOLS is not set
# BR2_PACKAGE_ALSA_LIB_TOPOLOGY is not set
BR2_PACKAGE_CAN_UTILS=y
# BR2_PACKAGE_DROPBEAR is not set
# BR2_PACKAGE_IPROUTE2 is not set
BR2_PACKAGE_IW=y
# BR2_PACKAGE_MEMTESTER is not set
# BR2_PACKAGE_TCPDUMP is not set
BR2_PACKAGE_DTC=y
BR2_PACKAGE_COREMARK=y
BR2_PACKAGE_ESP_SIMD=y
BR2_PACKAGE_S31_TOOLS=y
BR2_PACKAGE_BTSTACK_S31=y
BR2_TARGET_ROOTFS_SQUASHFS=y
BR2_TARGET_ROOTFS_SQUASHFS_BS_128K=y
BR2_TARGET_ROOTFS_SQUASHFS4_XZ=y
BR2_TARGET_ROOTFS_SQUASHFS_EXTREME_COMP=y
# BR2_TARGET_ROOTFS_TAR is not set
```

## buildroot-external/package/btstack-s31/Config.in
```kconfig
config BR2_PACKAGE_BTSTACK_S31
	bool "btstack-s31"
	depends on BR2_USE_MMU
	depends on BR2_TOOLCHAIN_HAS_THREADS
	select BR2_PACKAGE_BLUEZ5_UTILS_HEADERS
	help
	  Minimal BTstack Classic A2DP sink and BLE GAP/GATT peripheral for the
	  standard Linux HCI user-channel socket. Only BlueZ interface headers are
	  needed; no BlueZ daemon, D-Bus, BlueALSA or pairing agent is installed.

	  BTstack is licensed for personal/non-commercial use. Commercial use
	  requires a separate license from BlueKitchen GmbH. This package is
	  therefore intended only for experimental non-commercial images.
```

## buildroot-external/package/coremark-s31/Config.in
```kconfig
config BR2_PACKAGE_COREMARK_S31
	bool "CoreMark benchmark"
	default y
	help
	  Builds EEMBC CoreMark for the ESP32-S31 Linux userspace.
```

## buildroot-external/package/s31-crypto/Config.in
```kconfig
config BR2_PACKAGE_S31_CRYPTO
	bool "ESP32-S31 native crypto application backends"
	depends on !BR2_STATIC_LIBS
	select BR2_PACKAGE_OPENSSL
	select BR2_PACKAGE_LIBOPENSSL
	select BR2_PACKAGE_LIBOPENSSL_BIN
	select BR2_PACKAGE_LIBOPENSSL_ENABLE_MODULE
	help
	  OpenSSL provider using the native ESP32-S31 Crypto API drivers for
	  AES/SHA/HMAC, RSA and P-256/P-384 ECDH, plus native PKCS#11 key handles.
	  Requires the matching Linux ESP32-S31 crypto driver and UAPI.
```

## buildroot-external/package/s31-tools/Config.in
```kconfig
config BR2_PACKAGE_S31_TOOLS
	bool "ESP32-S31 runtime tools"
	default y
	select BR2_PACKAGE_OPENSSL
	help
	  Installs the device-tree overlay manager, radio module loader,
	  GPIO utility, WPA key derivation and persistent configuration archive helper.
	  Installs accelerator interface headers for native applications.
```

## esp-idf-uart-bench/sdkconfig.defaults
```kconfig
CONFIG_ESP_CONSOLE_NONE=y
CONFIG_BOOTLOADER_LOG_LEVEL_NONE=y
CONFIG_LOG_DEFAULT_LEVEL_NONE=y
CONFIG_FREERTOS_GENERATE_RUN_TIME_STATS=y
CONFIG_FREERTOS_UNICORE=y
```
